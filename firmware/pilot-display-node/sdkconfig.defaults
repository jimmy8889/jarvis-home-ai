## firmware/pilot-display-node/sdkconfig.defaults
```kconfig
CONFIG_IDF_TARGET="esp32c6"
CONFIG_APP_PROJECT_VER_FROM_CONFIG=y
CONFIG_APP_PROJECT_VER="0.2.6"
CONFIG_ESPTOOLPY_FLASHSIZE_16MB=y
CONFIG_PARTITION_TABLE_CUSTOM=y
CONFIG_PARTITION_TABLE_CUSTOM_FILENAME="partitions.csv"
CONFIG_COMPILER_OPTIMIZATION_PERF=y
CONFIG_FREERTOS_HZ=1000
CONFIG_LOG_COLORS=y

# The board exposes ESP32-C6's native USB Serial/JTAG device.
CONFIG_ESP_CONSOLE_USB_SERIAL_JTAG=y
CONFIG_ESP_CONSOLE_UART_DEFAULT=n

# LVGL settings for the no-PSRAM ESP32-C6.
CONFIG_LV_MEM_SIZE_KILOBYTES=64
CONFIG_LV_ATTRIBUTE_FAST_MEM_USE_IRAM=y
CONFIG_LV_FONT_MONTSERRAT_12=y
CONFIG_LV_FONT_MONTSERRAT_16=y
CONFIG_LV_FONT_MONTSERRAT_24=y
CONFIG_LV_FONT_MONTSERRAT_48=y
CONFIG_LV_BUILD_EXAMPLES=n
CONFIG_LV_BUILD_DEMOS=n
CONFIG_LV_USE_DEMO_WIDGETS=n
CONFIG_LV_USE_DEMO_BENCHMARK=n
CONFIG_LV_USE_DEMO_STRESS=n
CONFIG_LV_USE_DEMO_MUSIC=n

# Network defaults for a low-throughput always-on room node. The display board
# has no PSRAM, so keep the fixed Wi-Fi allocation deliberately small and use
# dynamic TX buffers. These values are ample for NTP and Pilot event traffic.
CONFIG_ESP_WIFI_STATIC_RX_BUFFER_NUM=4
CONFIG_ESP_WIFI_DYNAMIC_RX_BUFFER_NUM=8
CONFIG_ESP_WIFI_DYNAMIC_TX_BUFFER=y
CONFIG_ESP_WIFI_STATIC_TX_BUFFER=n
CONFIG_ESP_WIFI_DYNAMIC_TX_BUFFER_NUM=16
CONFIG_ESP_WIFI_RX_BA_WIN=4
CONFIG_ESP_WIFI_MGMT_SBUF_NUM=8
CONFIG_ESP_WIFI_GMAC_SUPPORT=n
CONFIG_LWIP_HOOK_IP6_INPUT_NONE=y
CONFIG_MBEDTLS_ECP_RESTARTABLE=y
CONFIG_MBEDTLS_GCM_SUPPORT_NON_AES_CIPHER=n
CONFIG_MBEDTLS_ECP_FIXED_POINT_OPTIM=y
CONFIG_MBEDTLS_CERTIFICATE_BUNDLE=y

# A pending OTA image must prove it can boot before it is marked valid. If it
# repeatedly fails during that window, the bootloader returns to the prior slot.
CONFIG_BOOTLOADER_APP_ROLLBACK_ENABLE=y
```
